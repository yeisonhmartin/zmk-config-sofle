/*
 * Copyright (c) 2020 Ryan Cross
 *
 * SPDX-License-Identifier: MIT
 */

#include "sofle.dtsi"

&kscan0 {
    col-gpios
        = <&pro_micro 19 GPIO_ACTIVE_HIGH>
        , <&pro_micro 18 GPIO_ACTIVE_HIGH>
        , <&pro_micro 15 GPIO_ACTIVE_HIGH>
        , <&pro_micro 14 GPIO_ACTIVE_HIGH>
        , <&pro_micro 16 GPIO_ACTIVE_HIGH>
        , <&pro_micro 10 GPIO_ACTIVE_HIGH>
        ;
};
/*
&left_encoder {
    status = "okay";
};
led_strip: ws2812@0 {
    compatible = "worldsemi,ws2812-spi";
    reg = <0>;
    spi-max-frequency = <4000000>;
    chain-length = <7>;
    spi-one-frame = <0x70>;
    spi-zero-frame = <0x40>;
    color-mapping = <LED_COLOR_ID_GREEN LED_COLOR_ID_RED LED_COLOR_ID_BLUE>;
};

&led_strip {
    status = "okay";
};

#include <dt-bindings/led/led.h>

led_strip: ws2812 {
    compatible = "sk6812"; // o "worldsemi,ws2812" también funciona
    chain-length = <7>;
    io-channels = <&gpio0 6>;  // ← Asegúrate de usar el mismo pin de datos que tenías en SPI (por ejemplo P0.06)
    color-mapping = <LED_COLOR_ID_GREEN LED_COLOR_ID_RED LED_COLOR_ID_BLUE>;
    status = "okay";
};

 */
